_gp = 0x8013C54C;
Anim_GetPos__FP15Trk_AnimateInstiiP8coorddefPiT4 = 0x8007412C;
Anim_gInstanceFromIndex = 0x8010E1CC;
AudioClc_CalcAzimuth__FP17DRender_tCalcViewP8coorddef = 0x80074BE8;
AudioClc_CalcDopplerShiftRatio__FP8coorddefT0 = 0x80074994;
AudioClc_gRenderView = 0x8010E428;
AudioCmn_GetAsyncSfx__Fiib = 0x80076900;
AudioCmn_PlaySFX__Fiiiiii = 0x800783CC;
BWorldSm_FindClosestSlice__FP8coorddefP12BWorldSm_Pos = 0x8007EA14;
BWorldSm_SetSlice__FiP12BWorldSm_Pos = 0x8007ED64;
BWorldSm_slices = 0x8013C7C0;
CopSpeak_gNumTrackSfx = 0x8013D0D4;
CopSpeak_Server__Fv = 0x8009A994;
DrawW_GetAnimationTime__FP15Trk_AnimateInst = 0x800C7644;
fixedmult = 0x800E4328;
freeVoiceChannel__Fi = 0x800780D0;
GameSetup_gData = 0x801131EC;
gettick = 0x800E8220;
gGameAudioList = 0x8013C730;
gMasterAmbientLevel = 0x8013C660;
Math_Dist3D__FP8coorddefT0 = 0x8009D438;
PAD_state = 0x800E41AC;
purgememadr = 0x800E5540;
random = 0x800E77A8;
reservememadr = 0x800E533C;
simGlobal = 0x8011E0AC;
SNDmemlargestunused = 0x800E7CEC;
SNDover = 0x800E7B14;
systemtask = 0x800E6C04;
SECTIONS { .text 0x8007C614 : { *(.text) } .rodata 0x80055864 : { *(.rodata) } .sdata 0x8013C754 : { *(.sdata) } /DISCARD/ : { *(.pdr) *(.reginfo) *(.MIPS.abiflags) *(.gnu.attributes) } }
