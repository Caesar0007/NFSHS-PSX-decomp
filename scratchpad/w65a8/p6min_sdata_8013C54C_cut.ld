SECTIONS
{
    .out 0x8013c54c :
    {
        build/asm/data/sdata_8013C54C_r00.sdata.s.o(.sdata);
        build/asm/data/sdata_8013C54C_o00.sdata.s.o(.sdata);
        build/asm/data/sdata_8013C54C_o01.sdata.s.o(.sdata);
        build/asm/data/sdata_8013C54C_o02.sdata.s.o(.sdata);
        build/asm/data/sdata_8013C54C_r01.sdata.s.o(.sdata);
        build/asm/data/sdata_8013C54C_o03.sdata.s.o(.sdata);
        build/asm/data/sdata_8013C54C_o04.sdata.s.o(.sdata);
        build/asm/data/sdata_8013C54C_r02.sdata.s.o(.sdata);
        build/asm/data/sdata_8013C54C_o05.sdata.s.o(.sdata);
        build/asm/data/sdata_8013C54C_o06.sdata.s.o(.sdata);
        build/asm/data/sdata_8013C54C_r03.sdata.s.o(.sdata);
        build/asm/data/sdata_8013C54C_o07.sdata.s.o(.sdata);
        build/asm/data/sdata_8013C54C_o08.sdata.s.o(.sdata);
        build/asm/data/sdata_8013C54C_r04.sdata.s.o(.sdata);
        build/asm/data/sdata_8013C54C_o09.sdata.s.o(.sdata);
        build/asm/data/sdata_8013C54C_r05.sdata.s.o(.sdata);
        build/asm/data/sdata_8013C54C_o10.sdata.s.o(.sdata);
        build/asm/data/sdata_8013C54C_r06.sdata.s.o(.sdata);
        build/asm/data/sdata_8013C54C_o11.sdata.s.o(.sdata);
        build/asm/data/sdata_8013C54C_r07.sdata.s.o(.sdata);
        build/asm/data/sdata_8013C54C_o12.sdata.s.o(.sdata);
        build/asm/data/sdata_8013C54C_r08.sdata.s.o(.sdata);
        build/asm/data/sdata_8013C54C_o13.sdata.s.o(.sdata);
        build/asm/data/sdata_8013C54C_o14.sdata.s.o(.sdata);
        build/asm/data/sdata_8013C54C_o15.sdata.s.o(.sdata);
        build/asm/data/sdata_8013C54C_o16.sdata.s.o(.sdata);
        build/asm/data/sdata_8013C54C_o17.sdata.s.o(.sdata);
        build/asm/data/sdata_8013C54C_r09.sdata.s.o(.sdata);
        build/asm/data/sdata_8013C54C_o18.sdata.s.o(.sdata);
        build/asm/data/sdata_8013C54C_o19.sdata.s.o(.sdata);
        build/asm/data/sdata_8013C54C_o20.sdata.s.o(.sdata);
        build/asm/data/sdata_8013C54C_r10.sdata.s.o(.sdata);
        build/asm/data/sdata_8013C54C_o21.sdata.s.o(.sdata);
        build/asm/data/sdata_8013C54C_r11.sdata.s.o(.sdata);
        build/asm/data/sdata_8013C54C_o22.sdata.s.o(.sdata);
        build/asm/data/sdata_8013C54C_r12.sdata.s.o(.sdata);
        build/asm/data/sdata_8013C54C_o23.sdata.s.o(.sdata);
        build/asm/data/sdata_8013C54C_r13.sdata.s.o(.sdata);
        build/asm/data/sdata_8013C54C_o24.sdata.s.o(.sdata);
        build/asm/data/sdata_8013C54C_r14.sdata.s.o(.sdata);
        build/asm/data/sdata_8013C54C_o25.sdata.s.o(.sdata);
        build/asm/data/sdata_8013C54C_r15.sdata.s.o(.sdata);
        build/asm/data/sdata_8013C54C_o26.sdata.s.o(.sdata);
        build/asm/data/sdata_8013C54C_r16.sdata.s.o(.sdata);
        build/asm/data/sdata_8013C54C_o27.sdata.s.o(.sdata);
        build/asm/data/sdata_8013C54C_o28.sdata.s.o(.sdata);
        build/asm/data/sdata_8013C54C_o29.sdata.s.o(.sdata);
        build/asm/data/sdata_8013C54C_r17.sdata.s.o(.sdata);
        build/asm/data/sdata_8013C54C_o30.sdata.s.o(.sdata);
        build/asm/data/sdata_8013C54C_r18.sdata.s.o(.sdata);
        build/asm/data/sdata_8013C54C_o31.sdata.s.o(.sdata);
        build/asm/data/sdata_8013C54C_r19.sdata.s.o(.sdata);
        build/asm/data/sdata_8013C54C_o32.sdata.s.o(.sdata);
        build/asm/data/sdata_8013C54C_r20.sdata.s.o(.sdata);
        build/asm/data/sdata_8013C54C_o33.sdata.s.o(.sdata);
        build/asm/data/sdata_8013C54C_r21.sdata.s.o(.sdata);
        build/asm/data/sdata_8013C54C_o34.sdata.s.o(.sdata);
        build/asm/data/sdata_8013C54C_o35.sdata.s.o(.sdata);
        build/asm/data/sdata_8013C54C_o36.sdata.s.o(.sdata);
        build/asm/data/sdata_8013C54C_r22.sdata.s.o(.sdata);
        build/asm/data/sdata_8013C54C_o37.sdata.s.o(.sdata);
        build/asm/data/sdata_8013C54C_r23.sdata.s.o(.sdata);
        build/asm/data/sdata_8013C54C_o38.sdata.s.o(.sdata);
        build/asm/data/sdata_8013C54C_r24.sdata.s.o(.sdata);
    }
    /DISCARD/ : { *(*) }
}
