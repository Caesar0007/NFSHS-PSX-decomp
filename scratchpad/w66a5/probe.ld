SECTIONS
{
    .t0000 0x800128f0 : SUBALIGN(4) { build/recon/game/common/minfront.cpp.o(.text) }
    .t0001 0x80012938 : SUBALIGN(4) { build/recon/game/psx/fe3dmenu.cpp.o(.text) }
    .t0002 0x80012fa0 : SUBALIGN(4) { build/recon/frontend/common/feapp.cpp.o(.text) }
    .t0003 0x80015780 : SUBALIGN(4) { build/recon/frontend/common/feaudio.cpp.o(.text) }
    .t0004 0x800186a8 : SUBALIGN(4) { build/recon/frontend/common/fedialog.cpp.o(.text) }
    .t0005 0x80019fe8 : SUBALIGN(4) { build/recon/frontend/common/femenuextended.cpp.o(.text) }
    .t0006 0x8001bf48 : SUBALIGN(4) { build/recon/frontend/common/femenuoptions.cpp.o(.text) }
    .t0007 0x80020cd8 : SUBALIGN(4) { build/recon/frontend/common/fetextrender.cpp.o(.text) }
    .t0008 0x80021a10 : SUBALIGN(4) { build/recon/frontend/common/fetracks.cpp.o(.text) }
    .t0009 0x80023240 : SUBALIGN(4) { build/recon/frontend/common/fecheats.cpp.o(.text) }
    .t0010 0x80023898 : SUBALIGN(4) { build/recon/frontend/common/feinput.cpp.o(.text) }
    .t0011 0x80023dd0 : SUBALIGN(4) { build/recon/frontend/common/femenu.cpp.o(.text) }
    .t0012 0x800268f0 : SUBALIGN(4) { build/recon/frontend/common/fetools.cpp.o(.text) }
    .t0013 0x80026e58 : SUBALIGN(4) { build/recon/frontend/common/front.cpp.o(.text) }
    .t0014 0x8002c0e0 : SUBALIGN(4) { build/recon/frontend/common/femenudefs.cpp.o(.text) }
    .t0015 0x80032228 : SUBALIGN(4) { build/recon/frontend/common/fetourn.cpp.o(.text) }
    .t0016 0x80034060 : SUBALIGN(4) { build/recon/frontend/common/femission.cpp.o(.text) }
    .t0017 0x800342a0 : SUBALIGN(4) { build/recon/frontend/common/fememcard.cpp.o(.text) }
    .t0018 0x80035ae8 : SUBALIGN(4) { build/recon/frontend/common/fecredits.cpp.o(.text) }
    .t0019 0x80036790 : SUBALIGN(4) { build/recon/frontend/common/fevideowall.cpp.o(.text) }
    .t0020 0x80036f20 : SUBALIGN(4) { build/recon/frontend/common/screenmain.cpp.o(.text) }
    .t0021 0x80038b68 : SUBALIGN(4) { build/recon/frontend/common/screenpinkslips.cpp.o(.text) }
    .t0022 0x800397f0 : SUBALIGN(4) { build/recon/frontend/common/screenpost.cpp.o(.text) }
    .t0023 0x8003a8f0 : SUBALIGN(4) { build/recon/frontend/common/screencarselect.cpp.o(.text) }
    .t0024 0x8003f778 : SUBALIGN(4) { build/recon/frontend/common/screentournselect.cpp.o(.text) }
    .t0025 0x80040570 : SUBALIGN(4) { build/recon/frontend/common/screentrophyroom.cpp.o(.text) }
    .t0026 0x80041008 : SUBALIGN(4) { build/recon/frontend/common/screentrophyinfo.cpp.o(.text) }
    .t0027 0x80041600 : SUBALIGN(4) { build/recon/frontend/common/screentracks.cpp.o(.text) }
    .t0028 0x800421f8 : SUBALIGN(4) { build/recon/frontend/common/screentrackinfo.cpp.o(.text) }
    .t0029 0x80042648 : SUBALIGN(4) { build/recon/frontend/common/screentrackrecords.cpp.o(.text) }
    .t0030 0x80043118 : SUBALIGN(4) { build/recon/frontend/common/screencontroller.cpp.o(.text) }
    .t0031 0x80045950 : SUBALIGN(4) { build/recon/frontend/common/screendisplay.cpp.o(.text) }
    .t0032 0x80045a28 : SUBALIGN(4) { build/recon/frontend/common/screenaudio.cpp.o(.text) }
    .t0033 0x80046320 : SUBALIGN(4) { build/recon/frontend/common/screenmemcard.cpp.o(.text) }
    .t0034 0x80047e60 : SUBALIGN(4) { build/recon/frontend/common/screencongrats.cpp.o(.text) }
    .t0035 0x80049840 : SUBALIGN(4) { build/recon/frontend/common/statchk.cpp.o(.text) }
    .t0036 0x8004a868 : SUBALIGN(4) { build/recon/frontend/common/stattool.cpp.o(.text) }
    .t0037 0x8004af88 : SUBALIGN(4) { build/recon/frontend/common/screenusername.cpp.o(.text) }
    .t0038 0x8004b7f8 : SUBALIGN(4) { build/recon/frontend/common/fefades.cpp.o(.text) }
    .t0039 0x8004bb38 : SUBALIGN(4) { build/recon/frontend/common/felines.cpp.o(.text) }
    .t0040 0x8004be00 : SUBALIGN(4) { build/recon/frontend/psx/drawshp.cpp.o(.text) }
    .t0041 0x8004c608 : SUBALIGN(4) { build/recon/frontend/psx/movie.cpp.o(.text) }
    .t0042 0x8004d6d8 : SUBALIGN(4) { build/recon/frontend/psx/mmeffect.cpp.o(.text) }
    .t0043 0x8004d778 : SUBALIGN(4) { build/recon/frontend/psx/psxfront.cpp.o(.text) }
    .t0044 0x8004f100 : SUBALIGN(4) { build/recon/frontend/psx/fetexture.cpp.o(.text) }
    .t0045 0x8004f3e0 : SUBALIGN(4) { build/recon/frontend/psx/memcard.c.o(.text) }
    .t0046 0x800508c0 : SUBALIGN(4) { build/recon/frontend/psx/mdec.cpp.o(.text) }
    .t0047 0x80050cc8 : SUBALIGN(4) { build/recon/frontend/psx/video.cpp.o(.text) }
    .t0048 0x8005797c : SUBALIGN(4) { build/recon/game/common/ai.cpp.o(.text) }
    .t0049 0x8005aa28 : SUBALIGN(4) { build/recon/game/common/aidelaycar.cpp.o(.text) }
    .t0050 0x8005ad94 : SUBALIGN(4) { build/recon/game/common/aihigh.cpp.o(.text) }
    .t0051 0x8005b500 : SUBALIGN(4) { build/recon/game/common/aih_basicperp.cpp.o(.text) }
    .t0052 0x8005c164 : SUBALIGN(4) { build/recon/game/common/aih_basiccop.cpp.o(.text) }
    .t0053 0x8005cb6c : SUBALIGN(4) { build/recon/game/common/aih_btccop.cpp.o(.text) }
    .t0054 0x8005f6b4 : SUBALIGN(4) { build/recon/game/common/aih_btcperp.cpp.o(.text) }
    .t0055 0x80061400 : SUBALIGN(4) { build/recon/game/common/aih_play.cpp.o(.text) }
    .t0056 0x80063270 : SUBALIGN(4) { build/recon/game/common/aih_hum.cpp.o(.text) }
    .t0057 0x80063310 : SUBALIGN(4) { build/recon/game/common/aih_opp.cpp.o(.text) }
    .t0058 0x80063c0c : SUBALIGN(4) { build/recon/game/common/aih_cop.cpp.o(.text) }
    .t0059 0x80065c8c : SUBALIGN(4) { build/recon/game/common/aih_traf.cpp.o(.text) }
    .t0060 0x800669ac : SUBALIGN(4) { build/recon/game/common/aicop.cpp.o(.text) }
    .t0061 0x80066bb0 : SUBALIGN(4) { build/recon/game/common/aiinit.cpp.o(.text) }
    .t0062 0x80067650 : SUBALIGN(4) { build/recon/game/common/ailife.cpp.o(.text) }
    .t0063 0x800689e8 : SUBALIGN(4) { build/recon/game/common/aiperson.cpp.o(.text) }
    .t0064 0x80069238 : SUBALIGN(4) { build/recon/game/common/aiphysic.cpp.o(.text) }
    .t0065 0x8006d5b4 : SUBALIGN(4) { build/recon/game/common/aispeeds.cpp.o(.text) }
    .t0066 0x8006f6f8 : SUBALIGN(4) { build/recon/game/common/aiscript.cpp.o(.text) }
    .t0067 0x8006f9a4 : SUBALIGN(4) { build/recon/game/common/aistate.cpp.o(.text) }
    .t0068 0x8007286c : SUBALIGN(4) { build/recon/game/common/aitriger.cpp.o(.text) }
    .t0069 0x80072e68 : SUBALIGN(4) { build/recon/game/common/aitune.cpp.o(.text) }
    .t0070 0x80072f90 : SUBALIGN(4) { build/recon/game/common/AIWORLD.cpp.o(.text) }
    .t0071 0x80073a94 : SUBALIGN(4) { build/recon/game/common/anim.cpp.o(.text) }
    .t0072 0x80074730 : SUBALIGN(4) { build/recon/game/common/audioclc.cpp.o(.text) }
    .t0073 0x80076420 : SUBALIGN(4) { build/recon/game/common/audiocmn.cpp.o(.text) }
    .t0074 0x80079ef4 : SUBALIGN(4) { build/recon/game/common/audiomus.cpp.o(.text) }
    .t0075 0x8007b52c : SUBALIGN(4) { build/recon/game/common/audedit.cpp.o(.text) }
    .t0076 0x8007b5a8 : SUBALIGN(4) { build/recon/game/common/audioeng.cpp.o(.text) }
    .t0077 0x8007c614 : SUBALIGN(4) { build/recon/game/common/audiotrk.cpp.o(.text) }
    .t0078 0x8007d5c8 : SUBALIGN(4) { build/recon/game/common/bworld.cpp.o(.text) }
    .t0079 0x8007e910 : SUBALIGN(4) { build/recon/game/common/bworldSm.cpp.o(.text) }
    .t0080 0x80080618 : SUBALIGN(4) { build/recon/game/common/camera.cpp.o(.text) }
    .t0081 0x80085d84 : SUBALIGN(4) { build/recon/game/common/cars.cpp.o(.text) }
    .t0082 0x8008b3fc : SUBALIGN(4) { build/recon/game/common/chunk.cpp.o(.text) }
    .t0083 0x8008b938 : SUBALIGN(4) { build/recon/game/common/clock.cpp.o(.text) }
    .t0084 0x8008ba70 : SUBALIGN(4) { build/recon/game/common/collide.cpp.o(.text) }
    .t0085 0x80091ec0 : SUBALIGN(4) { build/recon/game/common/color.cpp.o(.text) }
    .t0086 0x80091fdc : SUBALIGN(4) { build/recon/game/common/control.cpp.o(.text) }
    .t0087 0x80092464 : SUBALIGN(4) { build/recon/game/common/hudpmx.cpp.o(.text) }
    .t0088 0x80092f54 : SUBALIGN(4) { build/recon/game/common/spchevnt.c.o(.text) }
    .t0089 0x800942f0 : SUBALIGN(4) { build/recon/game/common/speech.cpp.o(.text) }
    .t0090 0x800993dc : SUBALIGN(4) { build/recon/game/common/copspeak.cpp.o(.text) }
    .t0091 0x8009aebc : SUBALIGN(4) { build/recon/game/common/dashhud.cpp.o(.text) }
    .t0092 0x8009b3c8 : SUBALIGN(4) { build/recon/game/common/fastrand.cpp.o(.text) }
    .t0093 0x8009b458 : SUBALIGN(4) { build/recon/game/common/genericpmx.cpp.o(.text) }
    .t0094 0x8009bd9c : SUBALIGN(4) { build/recon/game/common/gmesetup.cpp.o(.text) }
    .t0095 0x8009c128 : SUBALIGN(4) { build/recon/game/common/group.cpp.o(.text) }
    .t0096 0x8009c344 : SUBALIGN(4) { build/recon/game/common/input.cpp.o(.text) }
    .t0097 0x8009d3e4 : SUBALIGN(4) { build/recon/game/common/mathnfs.cpp.o(.text) }
    .t0098 0x8009ded4 : SUBALIGN(4) { build/recon/game/common/mpause.cpp.o(.text) }
    .t0099 0x8009ef2c : SUBALIGN(4) { build/recon/game/common/newton.cpp.o(.text) }
    .t0100 0x800a3d5c : SUBALIGN(4) { build/recon/game/common/new.cpp.o(.text) }
    .t0101 0x800a3dec : SUBALIGN(4) { build/recon/game/common/nfs3.cpp.o(.text) }
    .t0102 0x800a4ae4 : SUBALIGN(4) { build/recon/game/common/object.cpp.o(.text) }
    .t0103 0x800a6e14 : SUBALIGN(4) { build/recon/game/common/paths.cpp.o(.text) }
    .t0104 0x800a6e60 : SUBALIGN(4) { build/recon/game/common/pausemenu.cpp.o(.text) }
    .t0105 0x800ad5c8 : SUBALIGN(4) { build/recon/game/common/quatern.cpp.o(.text) }
    .t0106 0x800adc2c : SUBALIGN(4) { build/recon/game/common/r3dcar.cpp.o(.text) }
    .t0107 0x800b30ac : SUBALIGN(4) { build/recon/game/common/render.cpp.o(.text) }
    .t0108 0x800b3c4c : SUBALIGN(4) { build/recon/game/common/replay.cpp.o(.text) }
    .t0109 0x800b5f7c : SUBALIGN(4) { build/recon/game/common/scene.cpp.o(.text) }
    .t0110 0x800b61bc : SUBALIGN(4) { build/recon/game/common/schedule.cpp.o(.text) }
    .t0111 0x800b6574 : SUBALIGN(4) { build/recon/game/common/sim.cpp.o(.text) }
    .t0112 0x800b7250 : SUBALIGN(4) { build/recon/game/common/simplemem.cpp.o(.text) }
    .t0113 0x800b72ec : SUBALIGN(4) { build/recon/game/common/simqueue.cpp.o(.text) }
    .t0114 0x800b764c : SUBALIGN(4) { build/recon/game/common/souffle.cpp.o(.text) }
    .t0115 0x800b7f58 : SUBALIGN(4) { build/recon/game/common/stats.cpp.o(.text) }
    .t0116 0x800b9158 : SUBALIGN(4) { build/recon/game/common/textsys.cpp.o(.text) }
    .t0117 0x800b92f8 : SUBALIGN(4) { build/recon/game/common/track.cpp.o(.text) }
    .t0118 0x800bb068 : SUBALIGN(4) { build/recon/game/common/trgsfx.cpp.o(.text) }
    .t0119 0x800bba08 : SUBALIGN(4) { build/recon/game/common/udff.cpp.o(.text) }
    .t0120 0x800bbb84 : SUBALIGN(4) { build/recon/game/psx/audio.cpp.o(.text) }
    .t0121 0x800bbf10 : SUBALIGN(4) { build/recon/game/psx/cario.cpp.o(.text) }
    .t0122 0x800bdac0 : SUBALIGN(4) { build/recon/game/psx/draw.cpp.o(.text) }
    .t0123 0x800be6d0 : SUBALIGN(4) { build/recon/game/psx/drawc.cpp.o(.text) }
    .t0124 0x800ca998 : SUBALIGN(4) { build/recon/game/psx/force.cpp.o(.text) }
    .t0125 0x800cb20c : SUBALIGN(4) { build/recon/game/psx/font.cpp.o(.text) }
    .t0126 0x800cbcb0 : SUBALIGN(4) { build/recon/game/psx/flare.cpp.o(.text) }
    .t0127 0x800cf574 : SUBALIGN(4) { build/recon/game/psx/hrzsku.cpp.o(.text) }
    .t0128 0x800d1a80 : SUBALIGN(4) { build/recon/game/psx/hud.cpp.o(.text) }
    .t0129 0x800db0b8 : SUBALIGN(4) { build/recon/game/psx/loading.cpp.o(.text) }
    .t0130 0x800db318 : SUBALIGN(4) { build/recon/game/psx/night.cpp.o(.text) }
    .t0131 0x800dc4cc : SUBALIGN(4) { build/recon/game/psx/psxcontroller.cpp.o(.text) }
    .t0132 0x800dd050 : SUBALIGN(4) { build/recon/game/psx/sfx.cpp.o(.text) }
    .t0133 0x800de6f4 : SUBALIGN(4) { build/recon/game/psx/skidmark.cpp.o(.text) }
    .t0134 0x800df5b4 : SUBALIGN(4) { build/recon/game/psx/texture.cpp.o(.text) }
    .t0135 0x800e0884 : SUBALIGN(4) { build/recon/game/psx/textureprocess.cpp.o(.text) }
    .t0136 0x800e1544 : SUBALIGN(4) { build/recon/game/psx/trackspec.cpp.o(.text) }
    .t0137 0x800e192c : SUBALIGN(4) { build/recon/game/psx/trsproj.cpp.o(.text) }
    .t0138 0x800e1dc0 : SUBALIGN(4) { build/recon/game/psx/weather.cpp.o(.text) }
    .t0139 0x800e3d8c : SUBALIGN(4) { build/recon/game/psx/textpix.c.o(.text) }
    .t0140 0x800e3e40 : SUBALIGN(4) { build/recon/game/psx/textpsx.c.o(.text) }
    .t0141 0x800e3e68 : SUBALIGN(4) { build/recon/game/psx/unpack.c.o(.text) }
    .t0142 0x800e4024 : SUBALIGN(4) { build/recon/syslib/psx/2mbyte/2mbyte.c.o(.text) }
    .t0143 0x800e40e8 : SUBALIGN(4) { build/recon/eaclib/psx/pad.c.o(.text) }
    .t0144 0x800e4318 : SUBALIGN(4) { build/recon/syslib/psx/libc/C43.c.o(.text) }
    .t0145 0x800e4328 : SUBALIGN(4) { build/recon/eaclib/psx/eacpsxz/fixdmult.c.o(.text) }
    .t0146 0x800e4354 : SUBALIGN(4) { build/recon/syslib/psx/libsn/PUREV.c.o(.text) }
    .t0147 0x800e4358 : SUBALIGN(4) { build/recon/eaclib/psx/eacpsxz/trnspos.c.o(.text) }
    .t0148 0x800e4404 : SUBALIGN(4) { build/recon/eaclib/psx/eacpsxz/fixddiv.c.o(.text) }
    .t0149 0x800e44ac : SUBALIGN(4) { build/recon/syslib/psx/libapi/A39.c.o(.text) }
    .t0150 0x800e44bc : SUBALIGN(4) { build/recon/syslib/psx/libc/SPRINTF.c.o(.text) }
    .t0151 0x800e4d4c : SUBALIGN(4) { build/recon/eaclib/psx/eacpsxz/memstd.c.o(.text) }
    .t0152 0x800e5608 : SUBALIGN(4) { build/recon/eaclib/psx/eacpsxz/nsync.c.o(.text) }
    .t0153 0x800e5b28 : SUBALIGN(4) { build/recon/syslib/psx/libc/C25.c.o(.text) }
    .t0154 0x800e5b38 : SUBALIGN(4) { build/recon/eaclib/psx/eacpsxz/atanfunc.c.o(.text) }
    .t0155 0x800e5c64 : SUBALIGN(4) { build/recon/eaclib/psx/eacpsxz/nloadpk.c.o(.text) }
    .t0156 0x800e5d7c : SUBALIGN(4) { build/recon/syslib/psx/libc/C23.c.o(.text) }
    .t0157 0x800e5d8c : SUBALIGN(4) { build/recon/syslib/psx/libc/QSORT.c.o(.text) }
    .t0158 0x800e5f1c : SUBALIGN(4) { build/recon/eaclib/psx/eacpsxz/locatbig.c.o(.text) }
    .t0159 0x800e62cc : SUBALIGN(4) { build/recon/syslib/psx/libc/C36.c.o(.text) }
    .t0160 0x800e62dc : SUBALIGN(4) { build/recon/eaclib/psx/eacpsxz/blkmov.c.o(.text) }
    .t0161 0x800e65f8 : SUBALIGN(4) { build/recon/eaclib/psx/sndpsxz/sbremove.c.o(.text) }
    .t0162 0x800e6834 : SUBALIGN(4) { build/recon/eaclib/psx/sndpsxz/splysdef.c.o(.text) }
    .t0163 0x800e6884 : SUBALIGN(4) { build/recon/eaclib/psx/sndpsxz/span.c.o(.text) }
    .t0164 0x800e69d0 : SUBALIGN(4) { build/recon/eaclib/psx/sndpsxz/svol.c.o(.text) }
    .t0165 0x800e6af4 : SUBALIGN(4) { build/recon/eaclib/psx/eacpsxz/systask.c.o(.text) }
    .t0166 0x800e6cf0 : SUBALIGN(4) { build/recon/eaclib/psx/sndpsxz/sstsetpr.c.o(.text) }
    .t0167 0x800e6d58 : SUBALIGN(4) { build/recon/eaclib/psx/sndpsxz/seffect.c.o(.text) }
    .t0168 0x800e6e88 : SUBALIGN(4) { build/recon/eaclib/psx/spchpsxz/spchevnt.c.o(.text) }
    .t0169 0x800e77a8 : SUBALIGN(4) { build/recon/eaclib/psx/eacpsxz/random.c.o(.text) }
    .t0170 0x800e78e8 : SUBALIGN(4) { build/recon/syslib/psx/libc/C21.c.o(.text) }
    .t0171 0x800e78f8 : SUBALIGN(4) { build/recon/eaclib/psx/sndpsxz/sbend.c.o(.text) }
    .t0172 0x800e7a30 : SUBALIGN(4) { build/recon/eaclib/psx/sndpsxz/splay.c.o(.text) }
    .t0173 0x800e7b14 : SUBALIGN(4) { build/recon/eaclib/psx/sndpsxz/sover.c.o(.text) }
    .t0174 0x800e7b64 : SUBALIGN(4) { build/recon/eaclib/psx/sndpsxz/sbhdrsze.c.o(.text) }
    .t0175 0x800e7ba8 : SUBALIGN(4) { build/recon/eaclib/psx/sndpsxz/sbhdrcpy.c.o(.text) }
    .t0176 0x800e7cec : SUBALIGN(4) { build/recon/eaclib/psx/sndpsxz/sdmemlu.c.o(.text) }
    .t0177 0x800e7dec : SUBALIGN(4) { build/recon/eaclib/psx/sndpsxz/sbadd.c.o(.text) }
    .t0178 0x800e7e80 : SUBALIGN(4) { build/recon/eaclib/psx/sndpsxz/sstop.c.o(.text) }
    .t0179 0x800e7f08 : SUBALIGN(4) { build/recon/eaclib/psx/sndpsxz/spitch.c.o(.text) }
    .t0180 0x800e7ff0 : SUBALIGN(4) { build/recon/eaclib/psx/sndpsxz/smasterv.c.o(.text) }
    .t0181 0x800e80cc : SUBALIGN(4) { build/recon/syslib/psx/libc/A63.c.o(.text) }
    .t0182 0x800e80e4 : SUBALIGN(4) { build/recon/eaclib/psx/sndpsxz/s3dlow.c.o(.text) }
    .t0183 0x800e81a8 : SUBALIGN(4) { build/recon/eaclib/psx/sndpsxz/sstopall.c.o(.text) }
    .t0184 0x800e8220 : SUBALIGN(4) { build/recon/eaclib/psx/eacpsxz/timer.c.o(.text) }
    .t0185 0x800e82d0 : SUBALIGN(4) { build/recon/eaclib/psx/sndpsxz/sautovol.c.o(.text) }
    .t0186 0x800e83ec : SUBALIGN(4) { build/recon/eaclib/psx/sndpsxz/sstgetv.c.o(.text) }
    .t0187 0x800e8448 : SUBALIGN(4) { build/recon/syslib/psx/libcd/TYPE.c.o(.text) }
    .t0188 0x800e86d8 : SUBALIGN(4) { build/recon/eaclib/psx/sndpsxz/sststat.c.o(.text) }
    .t0189 0x800e87d0 : SUBALIGN(4) { build/recon/eaclib/psx/sndpsxz/sstrstat.c.o(.text) }
    .t0190 0x800e8940 : SUBALIGN(4) { build/recon/eaclib/psx/eacpsxz/wildcard.c.o(.text) }
    .t0191 0x800e8c14 : SUBALIGN(4) { build/recon/eaclib/psx/sndpsxz/sst.c.o(.text) }
    .t0192 0x800e9b44 : SUBALIGN(4) { build/recon/eaclib/psx/sndpsxz/spvoices.c.o(.text) }
    .t0193 0x800e9d30 : SUBALIGN(4) { build/recon/eaclib/psx/sndpsxz/sstsetgl.c.o(.text) }
    .t0194 0x800e9d8c : SUBALIGN(4) { build/recon/eaclib/psx/sndpsxz/sstsetgs.c.o(.text) }
    .t0195 0x800e9de8 : SUBALIGN(4) { build/recon/eaclib/psx/sndpsxz/sstautov.c.o(.text) }
    .t0196 0x800e9e70 : SUBALIGN(4) { build/recon/syslib/psx/libapi/COUNTER.c.o(.text) }
    .t0197 0x800e9f74 : SUBALIGN(4) { build/recon/syslib/psx/libc/C27.c.o(.text) }
    .t0198 0x800e9f84 : SUBALIGN(4) { build/recon/eaclib/psx/sndpsxz/slimits.c.o(.text) }
    .t0199 0x800ea054 : SUBALIGN(4) { build/recon/eaclib/psx/sndpsxz/sstovrhd.c.o(.text) }
    .t0200 0x800ea0d8 : SUBALIGN(4) { build/recon/eaclib/psx/sndpsxz/sstvol.c.o(.text) }
    .t0201 0x800ea138 : SUBALIGN(4) { build/recon/eaclib/psx/sndpsxz/sserver.c.o(.text) }
    .t0202 0x800ea6cc : SUBALIGN(4) { build/recon/eaclib/psx/eacpsxz/syncfile.c.o(.text) }
    .t0203 0x800eaac4 : SUBALIGN(4) { build/recon/syslib/psx/libc/C42.c.o(.text) }
    .t0204 0x800eaad4 : SUBALIGN(4) { build/recon/syslib/psx/libc/C47.c.o(.text) }
    .t0205 0x800eaae4 : SUBALIGN(4) { build/recon/eaclib/psx/eacpsxz/crossprd.c.o(.text) }
    .t0206 0x800eab9c : SUBALIGN(4) { build/recon/syslib/psx/libgte/REG13.c.o(.text) }
    .t0207 0x800eabac : SUBALIGN(4) { build/recon/eaclib/psx/eacpsxz/fxform.c.o(.text) }
    .t0208 0x800eacd8 : SUBALIGN(4) { build/recon/eaclib/psx/eacpsxz/asinfunc.c.o(.text) }
    .t0209 0x800eadbc : SUBALIGN(4) { build/recon/eaclib/psx/eacpsxz/isincos.c.o(.text) }
    .t0210 0x800eaed8 : SUBALIGN(4) { build/recon/eaclib/psx/eacpsxz/trnsfrm.c.o(.text) }
    .t0211 0x800eafe8 : SUBALIGN(4) { build/recon/eaclib/psx/eacpsxz/addtimer.c.o(.text) }
    .t0212 0x800eb080 : SUBALIGN(4) { build/recon/eaclib/psx/eacpsxz/savegp.c.o(.text) }
    .t0213 0x800eb0ac : SUBALIGN(4) { build/recon/eaclib/psx/eacpsxz/fixdsqrt.c.o(.text) }
    .t0214 0x800eb100 : SUBALIGN(4) { build/recon/syslib/psx/libc/C16.c.o(.text) }
    .t0215 0x800eb110 : SUBALIGN(4) { build/recon/eaclib/psx/eacpsxz/locatshp.c.o(.text) }
    .t0216 0x800eb1d0 : SUBALIGN(4) { build/recon/syslib/psx/libc/C24.c.o(.text) }
    .t0217 0x800eb1e0 : SUBALIGN(4) { build/recon/eaclib/psx/spchpsxz/spchbank.c.o(.text) }
    .t0218 0x800eb5a4 : SUBALIGN(4) { build/recon/eaclib/psx/spchpsxz/spchinit.c.o(.text) }
    .t0219 0x800eb7e4 : SUBALIGN(4) { build/recon/syslib/psx/libmath/FLTSIDF.c.o(.text) }
    .t0220 0x800eb8e4 : SUBALIGN(4) { build/recon/syslib/psx/libmath/LTDF2.c.o(.text) }
    .t0221 0x800eb9c4 : SUBALIGN(4) { build/recon/eaclib/psx/spchpsxz/spchrand.c.o(.text) }
    .t0222 0x800ebbd4 : SUBALIGN(4) { build/recon/eaclib/psx/spchpsxz/spchrslv.c.o(.text) }
    .t0223 0x800ebbf4 : SUBALIGN(4) { build/recon/eaclib/psx/eacpsxz/nfile.c.o(.text) }
    .t0224 0x800ed338 : SUBALIGN(4) { build/recon/eaclib/psx/sndpsxz/stimerem.c.o(.text) }
    .t0225 0x800ed3ec : SUBALIGN(4) { build/recon/eaclib/psx/eacpsxz/fixdinv.c.o(.text) }
    .t0226 0x800ed424 : SUBALIGN(4) { build/recon/eaclib/psx/eacpsxz/fixdsin.c.o(.text) }
    .t0227 0x800ed528 : SUBALIGN(4) { build/recon/eaclib/psx/eacpsxz/fixdatan.c.o(.text) }
    .t0228 0x800ed670 : SUBALIGN(4) { build/recon/syslib/psx/libgpu/SYS.c.o(.text) }
    .t0229 0x800efe60 : SUBALIGN(4) { build/recon/syslib/psx/libpad/PADENTRY.c.o(.text) }
    .t0230 0x800f01fc : SUBALIGN(4) { build/recon/eaclib/psx/eacpsxz/matrix.c.o(.text) }
    .t0231 0x800f0514 : SUBALIGN(4) { build/recon/syslib/psx/libmath/GTDF2.c.o(.text) }
    .t0232 0x800f05f4 : SUBALIGN(4) { build/recon/eaclib/psx/eacpsxz/primate.c.o(.text) }
    .t0233 0x800f0738 : SUBALIGN(4) { build/recon/eaclib/psx/eacpsxz/movf.c.o(.text) }
    .t0234 0x800f0aac : SUBALIGN(4) { build/recon/eaclib/psx/eacpsxz/shpsubs.c.o(.text) }
    .t0235 0x800f0b1c : SUBALIGN(4) { build/recon/eaclib/psx/eacpsxz/nasync.c.o(.text) }
    .t0236 0x800f1770 : SUBALIGN(4) { build/recon/syslib/psx/libetc/VMODE.c.o(.text) }
    .t0237 0x800f17a0 : SUBALIGN(4) { build/recon/eaclib/psx/eacpsxz/blkfill.c.o(.text) }
    .t0238 0x800f18e4 : SUBALIGN(4) { build/recon/eaclib/psx/eacpsxz/sinfunc.c.o(.text) }
    .t0239 0x800f1950 : SUBALIGN(4) { build/recon/eaclib/psx/eacpsxz/resize.c.o(.text) }
    .t0240 0x800f1ac8 : SUBALIGN(4) { build/recon/syslib/psx/libgte/MSC02.c.o(.text) }
    .t0241 0x800f1bfc : SUBALIGN(4) { build/recon/syslib/psx/libgpu/P00.c.o(.text) }
    .t0242 0x800f1c3c : SUBALIGN(4) { build/recon/eaclib/psx/eacpsxz/loadshp.c.o(.text) }
    .t0243 0x800f1cf8 : SUBALIGN(4) { build/recon/eaclib/psx/eacpsxz/exit.c.o(.text) }
    .t0244 0x800f1d58 : SUBALIGN(4) { build/recon/eaclib/psx/sndpsxz/ssysinit.c.o(.text) }
    .t0245 0x800f2130 : SUBALIGN(4) { build/recon/eaclib/psx/sndpsxz/ssysreal.c.o(.text) }
    .t0246 0x800f21a4 : SUBALIGN(4) { build/recon/syslib/psx/libgte/MSC00.c.o(.text) }
    .t0247 0x800f222c : SUBALIGN(4) { build/recon/syslib/psx/libgpu/EXT.c.o(.text) }
    .t0248 0x800f231c : SUBALIGN(4) { build/recon/syslib/psx/libetc/VSYNC.c.o(.text) }
    .t0249 0x800f252c : SUBALIGN(4) { build/recon/syslib/psx/libgte/FGO_01.c.o(.text) }
    .t0250 0x800f27bc : SUBALIGN(4) { build/recon/syslib/psx/libgte/REG11.c.o(.text) }
    .t0251 0x800f27dc : SUBALIGN(4) { build/recon/syslib/psx/libgte/FOG_01.c.o(.text) }
    .t0252 0x800f284c : SUBALIGN(4) { build/recon/syslib/psx/libetc/INTR.c.o(.text) }
    .t0253 0x800f3024 : SUBALIGN(4) { build/recon/eaclib/psx/eacpsxz/getm.c.o(.text) }
    .t0254 0x800f30ac : SUBALIGN(4) { build/recon/eaclib/psx/eacpsxz/textcrnt.c.o(.text) }
    .t0255 0x800f30fc : SUBALIGN(4) { build/recon/syslib/psx/libgpu/P10.c.o(.text) }
    .t0256 0x800f312c : SUBALIGN(4) { build/recon/syslib/psx/libgte/FGO_06.c.o(.text) }
    .t0257 0x800f32cc : SUBALIGN(4) { build/recon/eaclib/psx/eacpsxz/isqrt.c.o(.text) }
    .t0258 0x800f3490 : SUBALIGN(4) { build/recon/syslib/psx/libgpu/P19.c.o(.text) }
    .t0259 0x800f34b0 : SUBALIGN(4) { build/recon/syslib/psx/libmath/MULSF3.c.o(.text) }
    .t0260 0x800f35f0 : SUBALIGN(4) { build/recon/syslib/psx/libgpu/P12.c.o(.text) }
    .t0261 0x800f3610 : SUBALIGN(4) { build/recon/syslib/psx/libgpu/P16.c.o(.text) }
    .t0262 0x800f3630 : SUBALIGN(4) { build/recon/syslib/psx/libgpu/P18.c.o(.text) }
    .t0263 0x800f3650 : SUBALIGN(4) { build/recon/syslib/psx/libgpu/P17.c.o(.text) }
    .t0264 0x800f3670 : SUBALIGN(4) { build/recon/eaclib/psx/eacpsxz/fsincos.c.o(.text) }
    .t0265 0x800f3728 : SUBALIGN(4) { build/recon/syslib/psx/libgte/COR_02.c.o(.text) }
    .t0266 0x800f37f8 : SUBALIGN(4) { build/recon/syslib/psx/libgte/COR_03.c.o(.text) }
    .t0267 0x800f3938 : SUBALIGN(4) { build/recon/syslib/psx/libmath/FIXSFSI.c.o(.text) }
    .t0268 0x800f39f8 : SUBALIGN(4) { build/recon/eaclib/psx/eacpsxz/joystkn.c.o(.text) }
    .t0269 0x800f3a34 : SUBALIGN(4) { build/recon/eaclib/psx/eacpsxz/fileroot.c.o(.text) }
    .t0270 0x800f4178 : SUBALIGN(4) { build/recon/eaclib/psx/eacpsxz/meminit.c.o(.text) }
    .t0271 0x800f4180 : SUBALIGN(4) { build/recon/eaclib/psx/eacpsxz/inittmr.c.o(.text) }
    .t0272 0x800f43d4 : SUBALIGN(4) { build/recon/syslib/psx/libapi/C68.c.o(.text) }
    .t0273 0x800f43e4 : SUBALIGN(4) { build/recon/eaclib/psx/eacpsxz/shpdepth.c.o(.text) }
    .t0274 0x800f4450 : SUBALIGN(4) { build/recon/syslib/psx/libgpu/P01.c.o(.text) }
    .t0275 0x800f4470 : SUBALIGN(4) { build/recon/eaclib/psx/eacpsxz/textfor.c.o(.text) }
    .t0276 0x800f459c : SUBALIGN(4) { build/recon/eaclib/psx/eacpsxz/unhuff.c.o(.text) }
    .t0277 0x800f52b8 : SUBALIGN(4) { build/recon/eaclib/psx/eacpsxz/unref.c.o(.text) }
    .t0278 0x800f55b4 : SUBALIGN(4) { build/recon/eaclib/psx/eacpsxz/unbtree.c.o(.text) }
    .t0279 0x800f57c4 : SUBALIGN(4) { build/recon/syslib/psx/libmath/EXTSFDF2.c.o(.text) }
    .t0280 0x800f5924 : SUBALIGN(4) { build/recon/syslib/psx/libmath/TRUDFSF2.c.o(.text) }
    .t0281 0x800f5a54 : SUBALIGN(4) { build/recon/syslib/psx/libmath/ADDDF3.c.o(.text) }
    .t0282 0x800f5dd4 : SUBALIGN(4) { build/recon/syslib/psx/libmath/DIVDF3.c.o(.text) }
    .t0283 0x800f6104 : SUBALIGN(4) { build/recon/syslib/psx/libc/C26.c.o(.text) }
    .t0284 0x800f6114 : SUBALIGN(4) { build/recon/eaclib/psx/eacpsxz/nullfunc.c.o(.text) }
    .t0285 0x800f611c : SUBALIGN(4) { build/recon/syslib/psx/libgpu/P11.c.o(.text) }
    .t0286 0x800f614c : SUBALIGN(4) { build/recon/eaclib/psx/eacpsxz/crc.c.o(.text) }
    .t0287 0x800f6214 : SUBALIGN(4) { build/recon/syslib/psx/libc/C30.c.o(.text) }
    .t0288 0x800f6224 : SUBALIGN(4) { build/recon/syslib/psx/libmath/FLTSISF.c.o(.text) }
    .t0289 0x800f62e4 : SUBALIGN(4) { build/recon/syslib/psx/libmath/MULDF3.c.o(.text) }
    .t0290 0x800f66e4 : SUBALIGN(4) { build/recon/syslib/psx/libmath/DIVSF3.c.o(.text) }
    .t0291 0x800f6834 : SUBALIGN(4) { build/recon/syslib/psx/libmath/FIXDFSI.c.o(.text) }
    .t0292 0x800f6934 : SUBALIGN(4) { build/recon/eaclib/psx/eacpsxz/vramfxya.c.o(.text) }
    .t0293 0x800f6c3c : SUBALIGN(4) { build/recon/eaclib/psx/eacpsxz/shpclut.c.o(.text) }
    .t0294 0x800f6d18 : SUBALIGN(4) { build/recon/syslib/psx/libgpu/FONT.c.o(.text) }
    .t0295 0x800f7400 : SUBALIGN(4) { build/recon/syslib/psx/libpress/VLC.c.o(.text) }
    .t0296 0x800f7780 : SUBALIGN(4) { build/recon/syslib/psx/libcd/cdcont.c.o(.text) }
    .t0297 0x800f7e94 : SUBALIGN(4) { build/recon/syslib/psx/libcd/stcdint.c.o(.text) }
    .t0298 0x800f89c8 : SUBALIGN(4) { build/recon/syslib/psx/libpress/LIBPRESS.c.o(.text) }
    .t0299 0x800f8ec8 : SUBALIGN(4) { build/recon/syslib/psx/libcd/streamhelp.c.o(.text) }
    .t0300 0x800f9ae8 : SUBALIGN(4) { build/recon/eaclib/psx/eacpsxz/cdfs.c.o(.text) }
    .t0301 0x800faa44 : SUBALIGN(4) { build/recon/eaclib/psx/sndpsxz/scdvol.c.o(.text) }
    .t0302 0x800faaac : SUBALIGN(4) { build/recon/syslib/psx/libmcrd/LIBMCRD.c.o(.text) }
    .t0303 0x800fc250 : SUBALIGN(4) { build/recon/eaclib/psx/eacpsxz/cluttype.c.o(.text) }
    .t0304 0x800fc294 : SUBALIGN(4) { build/recon/eaclib/psx/eacpsxz/shptype.c.o(.text) }
    .t0305 0x800fc2f8 : SUBALIGN(4) { build/recon/eaclib/psx/eacpsxz/stream.c.o(.text) }
    .t0306 0x800fdd18 : SUBALIGN(4) { build/recon/syslib/psx/libapi/C57.c.o(.text) }
    .t0307 0x800fdd28 : SUBALIGN(4) { build/recon/syslib/psx/libpad/PADPORTD.c.o(.text) }
    .t0308 0x800fe388 : SUBALIGN(4) { build/recon/syslib/psx/libc/C46.c.o(.text) }
    .t0309 0x800fe398 : SUBALIGN(4) { build/recon/syslib/psx/libc/MEMMOVE.c.o(.text) }
    .t0310 0x800fe408 : SUBALIGN(4) { build/recon/eaclib/psx/eacpsxz/threads.c.o(.text) }
    .t0311 0x800fe424 : SUBALIGN(4) { build/recon/eaclib/psx/eacpsxz/callback.c.o(.text) }
    .t0312 0x800fe488 : SUBALIGN(4) { build/recon/eaclib/psx/eacpsxz/math64a.c.o(.text) }
    .t0313 0x800fe520 : SUBALIGN(4) { build/recon/eaclib/psx/eacpsxz/stricmp.c.o(.text) }
    .t0314 0x800fe594 : SUBALIGN(4) { build/recon/eaclib/psx/sndpsxz/sdata.c.o(.text) }
    .t0315 0x800fe5b4 : SUBALIGN(4) { build/recon/eaclib/psx/sndpsxz/sbirmpat.c.o(.text) }
    .t0316 0x800fe6bc : SUBALIGN(4) { build/recon/eaclib/psx/sndpsxz/sbvalid.c.o(.text) }
    .t0317 0x800fe724 : SUBALIGN(4) { build/recon/eaclib/psx/sndpsxz/salloc.c.o(.text) }
    .t0318 0x800fee30 : SUBALIGN(4) { build/recon/eaclib/psx/sndpsxz/s3dpos.c.o(.text) }
    .t0319 0x800fef4c : SUBALIGN(4) { build/recon/eaclib/psx/sndpsxz/spatkey.c.o(.text) }
    .t0320 0x800ff5a8 : SUBALIGN(4) { build/recon/eaclib/psx/sndpsxz/slib.c.o(.text) }
    .t0321 0x800ffe90 : SUBALIGN(4) { build/recon/eaclib/psx/sndpsxz/sdriver.c.o(.text) }
    .t0322 0x801001ec : SUBALIGN(4) { build/recon/eaclib/psx/sndpsxz/sdfx.c.o(.text) }
    .t0323 0x801005bc : SUBALIGN(4) { build/recon/eaclib/psx/sndpsxz/sfxlevel.c.o(.text) }
    .t0324 0x80100710 : SUBALIGN(4) { build/recon/eaclib/psx/spchpsxz/spchdata.c.o(.text) }
    .t0325 0x8010077c : SUBALIGN(4) { build/recon/eaclib/psx/spchpsxz/spchpick.c.o(.text) }
    .t0326 0x80101900 : SUBALIGN(4) { build/recon/eaclib/psx/sndpsxz/sclcptch.c.o(.text) }
    .t0327 0x80101abc : SUBALIGN(4) { build/recon/eaclib/psx/sndpsxz/stagpat.c.o(.text) }
    .t0328 0x8010266c : SUBALIGN(4) { build/recon/eaclib/psx/sndpsxz/sbdload.c.o(.text) }
    .t0329 0x801027bc : SUBALIGN(4) { build/recon/eaclib/psx/sndpsxz/sballoc.c.o(.text) }
    .t0330 0x80102810 : SUBALIGN(4) { build/recon/eaclib/psx/sndpsxz/sgetvol.c.o(.text) }
    .t0331 0x801028ac : SUBALIGN(4) { build/recon/syslib/psx/libc/C63.c.o(.text) }
    .t0332 0x801028bc : SUBALIGN(4) { build/recon/eaclib/psx/sndpsxz/spktplay.c.o(.text) }
    .t0333 0x80103424 : SUBALIGN(4) { build/recon/eaclib/psx/sndpsxz/smath64.c.o(.text) }
    .t0334 0x80103508 : SUBALIGN(4) { build/recon/eaclib/psx/sndpsxz/sstgetrp.c.o(.text) }
    .t0335 0x80103590 : SUBALIGN(4) { build/recon/syslib/psx/libc/C31.c.o(.text) }
    .t0336 0x801035a0 : SUBALIGN(4) { build/recon/syslib/psx/libc/C38.c.o(.text) }
    .t0337 0x801035b0 : SUBALIGN(4) { build/recon/eaclib/psx/sndpsxz/spat2hdr.c.o(.text) }
    .t0338 0x80103734 : SUBALIGN(4) { build/recon/syslib/psx/libc/MEMCMP.c.o(.text) }
    .t0339 0x80103784 : SUBALIGN(4) { build/recon/eaclib/psx/sndpsxz/sdpacket.c.o(.text) }
    .t0340 0x8010479c : SUBALIGN(4) { build/recon/eaclib/psx/sndpsxz/ssysserv.c.o(.text) }
    .t0341 0x801048e8 : SUBALIGN(4) { build/recon/syslib/psx/libmath/DBSHIFTU.c.o(.text) }
    .t0342 0x801049a8 : SUBALIGN(4) { build/recon/eaclib/psx/sndpsxz/sdtimrem.c.o(.text) }
    .t0343 0x80104a0c : SUBALIGN(4) { build/recon/syslib/psx/libapi/C73.c.o(.text) }
    .t0344 0x80104a1c : SUBALIGN(4) { build/recon/syslib/psx/libpad/PADMAIN.c.o(.text) }
    .t0345 0x801055f8 : SUBALIGN(4) { build/recon/syslib/psx/libpad/PADCMD.c.o(.text) }
    .t0346 0x80105f40 : SUBALIGN(4) { build/recon/eaclib/psx/eacpsxz/trnsmult.c.o(.text) }
    .t0347 0x80106084 : SUBALIGN(4) { build/recon/eaclib/psx/eacpsxz/fastmovf.c.o(.text) }
    .t0348 0x801061a8 : SUBALIGN(4) { build/recon/eaclib/psx/sndpsxz/smemman.c.o(.text) }
    .t0349 0x80106454 : SUBALIGN(4) { build/recon/syslib/psx/libgte/PATCHGTE.c.o(.text) }
    .t0350 0x80106534 : SUBALIGN(4) { build/recon/syslib/psx/libetc/INTR_VB.c.o(.text) }
    .t0351 0x80106654 : SUBALIGN(4) { build/recon/syslib/psx/libapi/A91.c.o(.text) }
    .t0352 0x80106664 : SUBALIGN(4) { build/recon/syslib/psx/libapi/L10.c.o(.text) }
    .t0353 0x80106674 : SUBALIGN(4) { build/recon/syslib/psx/libgte/REG03.c.o(.text) }
    .t0354 0x8010668c : SUBALIGN(4) { build/recon/syslib/psx/libc/C19.c.o(.text) }
    .t0355 0x8010669c : SUBALIGN(4) { build/recon/syslib/psx/libapi/A25.c.o(.text) }
    .t0356 0x80106954 : SUBALIGN(4) { build/recon/syslib/psx/libapi/C114.c.o(.text) }
    .t0357 0x8010696c : SUBALIGN(4) { build/recon/syslib/psx/libapi/A37.c.o(.text) }
    .t0358 0x8010697c : SUBALIGN(4) { build/recon/syslib/psx/libapi/A23.c.o(.text) }
    .t0359 0x8010698c : SUBALIGN(4) { build/recon/syslib/psx/libapi/A36.c.o(.text) }
    .t0360 0x8010699c : SUBALIGN(4) { build/recon/syslib/psx/libapi/A24.c.o(.text) }
    .t0361 0x801069ac : SUBALIGN(4) { build/recon/eaclib/psx/eacpsxz/textcode.c.o(.text) }
    .t0362 0x801069c4 : SUBALIGN(4) { build/recon/eaclib/psx/eacpsxz/isqrttbl.c.o(.text) }
    .t0363 0x80106a54 : SUBALIGN(4) { build/recon/syslib/psx/libmath/FERR.c.o(.text) }
    .t0364 0x80106ac4 : SUBALIGN(4) { build/recon/syslib/psx/libgte/COR_01.c.o(.text) }
    .t0365 0x80106be4 : SUBALIGN(4) { build/recon/syslib/psx/libsn/READ.c.o(.text) }
    .t0366 0x80106ca4 : SUBALIGN(4) { build/recon/syslib/psx/libsn/OPEN.c.o(.text) }
    .t0367 0x80106cc4 : SUBALIGN(4) { build/recon/syslib/psx/libsn/FSINIT.c.o(.text) }
    .t0368 0x80106cd0 : SUBALIGN(4) { build/recon/syslib/psx/libsn/CREAT.c.o(.text) }
    .t0369 0x80106cf0 : SUBALIGN(4) { build/recon/eaclib/psx/eacpsxz/devsys.c.o(.text) }
    .t0370 0x80106d1c : SUBALIGN(4) { build/recon/syslib/psx/libsn/LSEEK.c.o(.text) }
    .t0371 0x80106d40 : SUBALIGN(4) { build/recon/syslib/psx/libsn/CLOSE.c.o(.text) }
    .t0372 0x80106d50 : SUBALIGN(4) { build/recon/syslib/psx/libsn/WRITE.c.o(.text) }
    .t0373 0x80106e10 : SUBALIGN(4) { build/recon/syslib/psx/libapi/A12.c.o(.text) }
    .t0374 0x80106e20 : SUBALIGN(4) { build/recon/syslib/psx/libapi/A08.c.o(.text) }
    .t0375 0x80106e30 : SUBALIGN(4) { build/recon/syslib/psx/libapi/A13.c.o(.text) }
    .t0376 0x80106e40 : SUBALIGN(4) { build/recon/syslib/psx/libmath/DBSHIFT.c.o(.text) }
    .t0377 0x80106f00 : SUBALIGN(4) { build/recon/syslib/psx/libmath/MAINASU.c.o(.text) }
    .t0378 0x80106f70 : SUBALIGN(4) { build/recon/syslib/psx/libmath/ADDMANT.c.o(.text) }
    .t0379 0x80107020 : SUBALIGN(4) { build/recon/syslib/psx/libgpu/P09.c.o(.text) }
    .t0380 0x80107040 : SUBALIGN(4) { build/recon/syslib/psx/libgpu/P06.c.o(.text) }
    .t0381 0x80107080 : SUBALIGN(4) { build/recon/syslib/psx/libcd/drv.c.o(.text) }
    .t0382 0x80108824 : SUBALIGN(4) { build/recon/syslib/psx/libds/DSCB.c.o(.text) }
    .t0383 0x80108878 : SUBALIGN(4) { build/recon/syslib/psx/libcd/cdread.c.o(.text) }
    .t0384 0x8010907c : SUBALIGN(4) { build/recon/syslib/psx/libc/C37.c.o(.text) }
    .t0385 0x8010908c : SUBALIGN(4) { build/recon/syslib/psx/libcd/event.c.o(.text) }
    .t0386 0x801091dc : SUBALIGN(4) { build/recon/syslib/psx/libc/BSEARCH.c.o(.text) }
    .t0387 0x8010929c : SUBALIGN(4) { build/recon/syslib/psx/libcd/toc.c.o(.text) }
    .t0388 0x801094ec : SUBALIGN(4) { build/recon/eaclib/psx/sndpsxz/sdcdvol.c.o(.text) }
    .t0389 0x80109550 : SUBALIGN(4) { build/recon/syslib/psx/libmcrd/BIOS.c.o(.text) }
    .t0390 0x80109c00 : SUBALIGN(4) { build/recon/syslib/psx/libmcrd/USERFUNC.c.o(.text) }
    .t0391 0x80109d10 : SUBALIGN(4) { build/recon/syslib/psx/libcard/C171.c.o(.text) }
    .t0392 0x80109d20 : SUBALIGN(4) { build/recon/syslib/psx/libcard/CARD.c.o(.text) }
    .t0393 0x80109d60 : SUBALIGN(4) { build/recon/syslib/psx/libcard/C172.c.o(.text) }
    .t0394 0x80109d70 : SUBALIGN(4) { build/recon/syslib/psx/libapi/A50.c.o(.text) }
    .t0395 0x80109d80 : SUBALIGN(4) { build/recon/syslib/psx/libapi/A54.c.o(.text) }
    .t0396 0x80109d90 : SUBALIGN(4) { build/recon/syslib/psx/libapi/A51.c.o(.text) }
    .t0397 0x80109da0 : SUBALIGN(4) { build/recon/syslib/psx/libapi/A52.c.o(.text) }
    .t0398 0x80109db0 : SUBALIGN(4) { build/recon/syslib/psx/libapi/A53.c.o(.text) }
    .t0399 0x80109dc0 : SUBALIGN(4) { build/recon/syslib/psx/libapi/FIRST.c.o(.text) }
    .t0400 0x8010a060 : SUBALIGN(4) { build/recon/syslib/psx/libapi/A67.c.o(.text) }
    .t0401 0x8010a070 : SUBALIGN(4) { build/recon/syslib/psx/libapi/A69.c.o(.text) }
    .t0402 0x8010a080 : SUBALIGN(4) { build/recon/syslib/psx/libapi/A65.c.o(.text) }
    .t0403 0x8010a090 : SUBALIGN(4) { build/recon/syslib/psx/libcard/A80.c.o(.text) }
    .t0404 0x8010a0a0 : SUBALIGN(4) { build/recon/syslib/psx/libcard/A78.c.o(.text) }
    .t0405 0x8010a0ac : SUBALIGN(4) { build/recon/syslib/psx/libpad/PADSEQD.c.o(.text) }
    .t0406 0x8010a540 : SUBALIGN(4) { build/recon/syslib/psx/libc/C40.c.o(.text) }
    .t0407 0x8010a550 : SUBALIGN(4) { build/recon/eaclib/psx/sndpsxz/sdmemman.c.o(.text) }
    .t0408 0x8010a880 : SUBALIGN(4) { build/recon/eaclib/psx/sndpsxz/sdma.c.o(.text) }
    .t0409 0x8010aedc : SUBALIGN(4) { build/recon/eaclib/psx/sndpsxz/saetodv.c.o(.text) }
    .t0410 0x8010b0a8 : SUBALIGN(4) { build/recon/eaclib/psx/sndpsxz/saetolrv.c.o(.text) }
    .t0411 0x8010b100 : SUBALIGN(4) { build/recon/eaclib/psx/spchpsxz/spchrule.c.o(.text) }
    .t0412 0x8010b5ac : SUBALIGN(4) { build/recon/eaclib/psx/spchpsxz/spchsamp.c.o(.text) }
    .t0413 0x8010b75c : SUBALIGN(4) { build/recon/eaclib/psx/sndpsxz/sdresolv.c.o(.text) }
    .t0414 0x8010ba48 : SUBALIGN(4) { build/recon/eaclib/psx/sndpsxz/sdplapat.c.o(.text) }
    .t0415 0x8010bcf4 : SUBALIGN(4) { build/recon/eaclib/psx/sndpsxz/srrange.c.o(.text) }
    .t0416 0x8010bd50 : SUBALIGN(4) { build/recon/eaclib/psx/sndpsxz/sgettag.c.o(.text) }
    .t0417 0x8010be80 : SUBALIGN(4) { build/recon/eaclib/psx/sndpsxz/srandom.c.o(.text) }
    .t0418 0x8010bf80 : SUBALIGN(4) { build/recon/eaclib/psx/sndpsxz/sdspuirq.c.o(.text) }
    .t0419 0x8010bfc8 : SUBALIGN(4) { build/recon/syslib/psx/libapi/L03.c.o(.text) }
    .t0420 0x8010bfd8 : SUBALIGN(4) { build/recon/syslib/psx/libapi/L02.c.o(.text) }
    .t0421 0x8010bfe8 : SUBALIGN(4) { build/recon/syslib/psx/libpad/WAITRC2.c.o(.text) }
    .t0422 0x8010c0a8 : SUBALIGN(4) { build/recon/syslib/psx/libpad/MCXMAIN.c.o(.text) }
    .t0423 0x8010c698 : SUBALIGN(4) { build/recon/syslib/psx/libgpu/P34.c.o(.text) }
    .t0424 0x8010c6f8 : SUBALIGN(4) { build/recon/syslib/psx/libapi/A07.c.o(.text) }
    .t0425 0x8010c708 : SUBALIGN(4) { build/recon/syslib/psx/libsn/SNREAD.c.o(.text) }
    .t0426 0x8010c720 : SUBALIGN(4) { build/recon/syslib/psx/libsn/SNWRITE.c.o(.text) }
    .t0427 0x8010c738 : SUBALIGN(4) { build/recon/eaclib/psx/sndpsxz/spvtolrv.c.o(.text) }
    .t0428 0x8010c784 : SUBALIGN(4) { build/recon/syslib/psx/libcard/INIT.c.o(.text) }
    .t0429 0x8010c7f0 : SUBALIGN(4) { build/recon/syslib/psx/libcard/CARDINIT.c.o(.text) }
    .t0430 0x8010c854 : SUBALIGN(4) { build/recon/syslib/psx/libapi/C112.c.o(.text) }
    .t0431 0x8010c864 : SUBALIGN(4) { build/recon/syslib/psx/libapi/A09.c.o(.text) }
    .t0432 0x8010c874 : SUBALIGN(4) { build/recon/syslib/psx/libapi/A11.c.o(.text) }
    .t0433 0x8010c884 : SUBALIGN(4) { build/recon/syslib/psx/libapi/A66.c.o(.text) }
    .t0434 0x8010c894 : SUBALIGN(4) { build/recon/eaclib/psx/sndpsxz/saelib.c.o(.text) }
    .t0435 0x8010c928 : SUBALIGN(4) { build/recon/eaclib/psx/sndpsxz/sgetdata.c.o(.text) }
    .t0436 0x8010c9b0 : SUBALIGN(4) { build/recon/syslib/psx/libapi/PAD.c.o(.text) }
    .t0437 0x8010c9c0 : SUBALIGN(4) { build/recon/syslib/psx/libcard/A74.c.o(.text) }
    .t0438 0x8010ca40 : SUBALIGN(4) { build/recon/syslib/psx/libcard/PATCH.c.o(.text) }
    .t0439 0x8010cba0 : SUBALIGN(4) { build/recon/syslib/psx/libcard/A75.c.o(.text) }
    .t0440 0x8010cbb0 : SUBALIGN(4) { build/recon/syslib/psx/libcard/A76.c.o(.text) }
    .t0441 0x8010cbc0 : SUBALIGN(4) { build/recon/syslib/psx/libcard/END.c.o(.text) }
    .t0442 0x8010cc40 : SUBALIGN(4) { build/recon/eaclib/psx/sndpsxz/ssine.c.o(.text) }
    .other 0x80300000 : { *(.data) *(.sdata) *(.rodata) *(.bss) *(.sbss) *(COMMON) }
    /DISCARD/ : { *(.pdr) *(.reginfo) *(.MIPS.abiflags) *(.gnu.attributes) *(.comment) }
}
